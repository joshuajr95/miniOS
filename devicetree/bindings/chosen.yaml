## devicetree/bindings/chosen.yaml
```yaml
# DT binding for the /chosen node
#
# Author: Joshua Jacobs-Rebhun
# Date: March 15, 2026

title: Device Tree binding for the /chosen node

compatible: "chosen"

properties:

  bootargs:
    type: string
    required: false
    description: The boot arguments to pass to the operating system on startup

  stdout-path:
    type: string
    required: false
    description: >
      A string that specifies the full path to the node
      representing the device to be used for
      console output. If the character “:” is present
      in the value it terminates the path. The value
      may be an alias. If the stdin-path property is
      not specified, stdout-path should be assumed
      to define the input device.

  stdin-path:
    type: string
    required: false
    description: >
      A string that specifies the full path to the node
      representing the device to be used for boot
      console input. If the character “:” is present
      in the value it terminates the path. The value
      may be an alias.
```

## devicetree/bindings/cpu.yaml
```yaml
# DT binding for /cpus/cpu* nodes
#
# Author: Joshua Jacobs-Rebhun
# Date: March 15, 2026

title: Binding for /cpus/cpu* node

compatible: "cpu"

properties:

  device_type:
    type: string
    required: true
    description: Type of the device. Always set to 'cpu'
    const: "cpu"

  reg:
    type: int
    required: true
    description: Address of the CPU. Basically just the CPU number

  clock-frequency:
    type: int
    required: true
    description: Frequency of the clock signal for the CPU

  timebase-frequency:
    type: int
    required: true
    description: Frequency of the timebase signal


  status:
    type: string
    required: true
    description: Status of the CPU
    enum:
      - "okay"
      - "disabled"
      - "fail"

  enable-method:
    type: string-array
    required: false
    description: Method to enable a second CPU
    enum:
      - "spin-table"
      - "psci"

  cpu-release-addr:
    type: int
    required: false
    description: Address at which to start second CPU running

  tlb-split:
    type: boolean
    required: false
    description: If present, denotes that there are separate TLBs for instructions and data

  tlb-size:
    type: int
    required: false
    description: The number of TLB entries. Required for unified TLBs (tlb-split not present)

  tlb-sets:
    type: int
    required: false
    description: The number of associativity sets for TLB. Required for unified TLBs.

  d-tlb-size:
    type: int
    required: false
    description: The number of data TLB entries. Required for split TLBs (tlb-split present)

  d-tlb-sets:
    type: int
    required: false
    description: The number of associativity sets for data TLB. Required for split TLBs.

  i-tlb-size:
    type: int
    required: false
    description: The number of instruction TLB entries. Required for split TLBs.

  i-tlb-sets:
    type: int
    required: false
    description: The number of associativity sets for instruction TLB. Required for split TLBs.
```

## devicetree/bindings/flash.yaml
```yaml
# DT binding for /flash nodes
#
# Author: Joshua Jacobs-Rebhun
# Date: April 7, 2026


title: Binding for the /flash node

properties:

  reg:
    type: array
    required: true
    description: The base address and memory size of the flash memory for program or boot code
    
```

## devicetree/bindings/memory.yaml
```yaml
# Device Tree binding file for main memory nodes
#
# Author: Joshua Jacobs-Rebhun
# Date: March 15, 2026


title: Binding for main memory nodes

compatible: "memory"

properties:

  device_type:
    type: string
    required: true
    description: Describes the type of the device. Always set to 'memory'
    const: "memory"

  reg:
    type: array
    required: true
    description: Address range for the main memory node.

  initial-mapped-area:
    type: array
    required: false
    description: Address range for the initial mapped area

  hotpluggable:
    type: boolean
    required: false
    description: Whether the memory can be added or removed during operation
```

## devicetree/bindings/microchip,pic32mx-bmxcon.yaml
```yaml
# DT binding for the PIC32MX series Bus Matrix controller
#
# Author: Joshua Jacobs-Rebhun
# Date: April 8, 2026

title: Binding for the PIC32MX Bus Matrix Controller node

compatible: "microchip,pic32mx-bmxcon"


properties:

  reg:
    type: array
    required: true
    description: Base address and memory size for the Bus Matrix Controller register block

  status:
    type: string
    required: true
    description: Status of the Bus Matrix Controller
    enum:
      - "okay"
      - "disabled"
      - "fail"
```

## devicetree/bindings/microchip,pic32mx-gpio.yaml
```yaml
# DT binding for PIC32MX GPIO controller
#
# Author: Joshua Jacobs-Rebhun
# Date: April 14, 2026


title: 

compatible: "microchip,pic32mxl-gpio"


properties:

  reg:
    type: array
    required: true
    description: Base address and memory size of memory-mapped register block

  gpio-controller:
    type: boolean
    required: true
    description: Marks this node as a GPIO controller

  "#gpio-cells":
    type: int
    required: true
    description: Number of 32-bit cells used to describe the GPIOs. The value must be 2, since one is the GPIO number and the other is flags
    const: 2

  status:
    type: string
    required: true
    description: Status of the node
    enum:
      - "okay"
      - "disabled"
      - "fail"
```

## devicetree/bindings/microchip,pic32mx-intcon.yaml
```yaml
# DT binding for the PIC32MX series interrupt controller
#
# Author: Joshua Jacobs-Rebhun
# Date: April 8, 2026


title: Binding for PIC32MX interrupt controller

compatible: "microchip,pic32mx-intcon"


properties:

  reg:
    type: array
    required: true
    description: Base address and memory size for interrupt controller register block

  interrupt-controller:
    type: boolean
    required: true
    description: Marks this node as an interrupt controller

  "#interrupt-cells":
    type: int
    required: true
    description: The number of 32-bit cells used to describe the 'interrupts' property of nodes that have this node as their 'interrupt-parent' property. Uses 2 cells, one for interrupt number and another for flags
    const: 2

  status:
    type: string
    required: true
    description: The status of this device
    enum:
      - "okay"
      - "disabled"
      - "fail"
```

## devicetree/bindings/microchip,pic32mx-nvm.yaml
```yaml
# DT binding for the PIC32MX series flash memory controller
#
# Author: Joshua Jacobs-Rebhun
# Date: April 8, 2026

title: Binding for the PIC32MX flash memory controller

compatible: "microchip,pic32mx-nvm"


properties:

  reg:
    type: array
    required: true
    description: Base address and memory size for the flash controller register block

  status:
    type: string
    required: true
    description: Status of the flash controller
    enum:
      - "okay"
      - "disabled"
      - "fail"
```

## devicetree/bindings/microchip,pic32mx-uart.yaml
```yaml
# DT binding for the PIC32MX series UART controllers
#
# Author: Joshua Jacobs-Rebhun
# Date: April 8, 2026

title: Binding for the PIC32MX UART controllers

compatible: "microchip,pic32mx-uart"


properties:

  reg:
    type: array
    required: true
    description: Base address and memory size for UART controller register block

  status:
    type: string
    required: true
    description: Status of UART controller
    enum:
      - "okay"
      - "disabled"
      - "fail"

  interrupt-parent:
    type: phandle
    required: true
    description: The parent in the interrupt tree for this node

  interrupts:
    type: array
    required: true
    description: The array of IRQ numbers and flags used by this node.
```

## devicetree/bindings/microchip,pic32mx795f512l.yaml
```yaml
# This file contains the Device Tree binding for the
# root node for the PIC32MX795F512L microcontroller
#
# Author: Joshua Jacobs-Rebhun
# Date: March 15, 2026

title: Binding for PIC32MX795F512L microcontroller


compatible: "microchip,pic32mx795f512l"

properties:

  model:
    type: string
    required: true
    description: The model name for the device.

  "#address-cells":
    type: int
    required: true
    description: The number of 32-bit cells used for the base address.
    const: 2

  "#size-cells":
    type: int
    required: true
    description: The number of 32-bit cells used for the size of the memory range.
    const: 2

  serial-number:
    type: string
    required: false
    description: The serial number for the SoC
  
  chassis-type:
    type: string
    required: false
    description: The type of form factor for the SoC
    enum:
      - "desktop"
      - "laptop"
      - "convertible"
      - "server"
      - "tablet"
      - "handset"
      - "watch"
      - "embedded"
```

## devicetree/bindings/simple-bus.yaml
```yaml
# DT binding for the /soc node and any other
# node that has the 'simple-bus' compatible
#
# Author: Joshua Jacobs-Rebhun
# Date: April 7, 2026


title: Binding for simple-bus

compatible: "simple-bus"

properties:

  "#address-cells":
    type: int
    required: true
    description: Number of 32-bit cells used to specify the base address for child nodes' 'reg' property

  "#size-cells":
    type: int
    required: true
    description: Number of 32-bit cells used to specify the size of memory for child nodes' 'reg' property

  interrupt-parent:
    type: phandle
    required: true
    description: Phandle to the node that serves as the interrupt controller for this node
```
